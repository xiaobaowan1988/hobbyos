/*
 * scripts/linker.ld — 内核链接脚本
 *
 * 链接脚本控制输出二进制文件的内存布局:
 *   - 各段 (.text, .data, .bss) 的排列顺序和地址
 *   - 入口点地址
 *   - 导出符号供汇编/C 代码引用
 *
 * 参考文档:
 *   [LD-MANUAL] GNU ld 手册 "3.4 SECTIONS Command"
 *   [QEMU-VIRT] QEMU virt 平台 RAM 起始地址 = 0x4000_0000
 */

/* ==================================================================
 * ENTRY(_start) — 指定程序入口点为 _start 符号
 *
 * 这告诉链接器 (以及 QEMU/引导加载器) 程序的第一条指令在 _start。
 * 参考: [LD-MANUAL] "3.4.1 Setting the Entry Point"
 * ================================================================== */
ENTRY(_start)

/* ==================================================================
 * SECTIONS — 定义输出文件的段布局
 *
 * '. = 0x40000000' 设置起始虚拟地址 (VMA)。
 * QEMU virt 使用 -kernel 选项时将映像加载到此地址。
 * 参考: [QEMU-VIRT] "RAM begins at 0x4000_0000"
 * ================================================================== */
SECTIONS
{
    /* 设置位置计数器(Location Counter)为 0x4000_0000
     * 这是 QEMU virt 平台 RAM 的起始地址。
     * 参考: [QEMU-VIRT] MemMapEntry virt_memmap[] 中 VIRT_MEM 项 */
    . = 0x40000000;

    /* ----------------------------------------------------------
     * .text.boot — 启动代码段 (必须在最前面!)
     *
     * 包含 _start 入口点。放在 0x4000_0000 起始处,
     * 确保 CPU 上电后执行到的第一条指令就是 _start。
     *
     * 参考: [LD-MANUAL] "3.6.1 Input Section Basics"
     * ---------------------------------------------------------- */
    .text.boot : {
        *(.text.boot)              /* 匹配所有输入文件中的 .text.boot 段 */
    }

    /* ----------------------------------------------------------
     * .text — 代码段
     *
     * 包含内核的所有函数代码。
     * ALIGN(4096) 确保页对齐 (4KB), 为后续 MMU 映射做准备。
     *
     * 参考: [LD-MANUAL] "3.6.4 Output Section Address"
     * ---------------------------------------------------------- */
    .text : ALIGN(4096) {
        *(.text .text.*)           /* 匹配所有 .text 和 .text.xxx 段 */
    }

    /* ----------------------------------------------------------
     * .rodata — 只读数据段
     *
     * 包含字符串常量、const 变量等。
     * 后续开启 MMU 后可将此段映射为只读以提高安全性。
     *
     * 参考: [LD-MANUAL] "3.6 SECTIONS Command"
     * ---------------------------------------------------------- */
    .rodata : ALIGN(4096) {
        *(.rodata .rodata.*)       /* 匹配所有 .rodata 段 */
    }

    /* ----------------------------------------------------------
     * .data — 已初始化数据段
     *
     * 包含有初始值的全局/静态变量。
     *
     * 参考: [LD-MANUAL] "3.6 SECTIONS Command"
     * ---------------------------------------------------------- */
    .data : ALIGN(4096) {
        __data_start = .;          /* 导出 .data 起始地址 (MMU 权限分界) */
        *(.data .data.*)           /* 匹配所有 .data 段 */
    }

    /* ----------------------------------------------------------
     * .bss — 未初始化数据段 (Block Started by Symbol)
     *
     * 包含未初始化的全局/静态变量, C 标准要求它们初始值为 0。
     * boot/start.S 中的 bss_loop 会将此段清零。
     *
     * __bss_start 和 __bss_end 是链接器导出的符号,
     * 供启动代码定位 BSS 段的范围。
     *
     * 参考: [LD-MANUAL] "3.5.5 PROVIDE"
     *        System V ABI §4.1 "Sections"
     * ---------------------------------------------------------- */
    .bss : ALIGN(4096) {
        __bss_start = .;           /* 导出 BSS 起始地址符号 */
        *(.bss .bss.*)             /* 匹配所有 .bss 段 */
        *(COMMON)                  /* 匹配 COMMON 块 (未指定段的符号) */
        __bss_end = .;             /* 导出 BSS 结束地址符号 */
    }

    /* ----------------------------------------------------------
     * _end — 内核映像结束地址
     *
     * 后续章节的内存管理器将从 _end 之后分配物理页。
     *
     * 参考: [LD-MANUAL] ". (Location Counter)"
     * ---------------------------------------------------------- */
    . = ALIGN(4096);
    _end = .;                      /* 导出内核结束地址符号 */

    /* ----------------------------------------------------------
     * /DISCARD/ — 丢弃不需要的段
     *
     * .comment 和 .note 段包含编译器版本信息等, 裸机不需要。
     *
     * 参考: [LD-MANUAL] "3.6.7 Output Section Discarding"
     * ---------------------------------------------------------- */
    /DISCARD/ : {
        *(.comment)
        *(.note .note.*)
    }
}
